## CMakeLists.txt
```
cmake_minimum_required(VERSION 3.20.0)

# Pull in the Zephyr build system
find_package(Zephyr REQUIRED HINTS $ENV{ZEPHYR_BASE})

project(dht22_sensor)

# Export compile commands for clangd (Neovim)
set(CMAKE_EXPORT_COMPILE_COMMANDS ON)

target_sources(app PRIVATE src/main.c)
```

## prj.conf
```kconfig
# printk() enable for console output
# CONFIG_PRINTK=y

# Enable Logging 
CONFIG_LOG=y
CONFIG_LOG_DEFAULT_LEVEL=3

# Enable GPIOS
CONFIG_GPIO=y

# Enable Sensors 
CONFIG_SENSOR=y

# Enable DHT
CONFIG_DHT=y

# Enable floating point formatting support
CONFIG_CBPRINTF_FP_SUPPORT=y
```

## boards/frdm_mcxa156.overlay
```dts
/ {
  dht22 {
    compatible = "aosong,dht";
    status = "okay";

    dio-gpios = <&gpio1 4 (GPIO_ACTIVE_LOW | GPIO_PULL_UP)>;

    dht22;
  };
};
```

## src/main.c
```c
#include <zephyr/kernel.h>
#include <zephyr/device.h>
#include <zephyr/drivers/sensor.h>
#include <zephyr/logging/log.h>

LOG_MODULE_REGISTER(dht22_logger, LOG_LEVEL_DBG);

int main(void)
{
  const struct device *const dht = DEVICE_DT_GET_ONE(aosong_dht);

  if (!device_is_ready(dht)) {
    LOG_ERR("Device %s is not ready.", dht -> name);
    return 0;
  }

  LOG_INF("Device %s found", dht -> name);

  struct sensor_value temp, humidity;

  while (1) {
    k_sleep(K_SECONDS(2));

    int ret = sensor_sample_fetch(dht);

    if (ret == 0) {
      sensor_channel_get(dht, SENSOR_CHAN_AMBIENT_TEMP, &temp);

      sensor_channel_get(dht, SENSOR_CHAN_HUMIDITY, &humidity);

      LOG_INF("Temperature (C): %.2f , Humidity(%%): %.2f",
               sensor_value_to_double(&temp),
               sensor_value_to_double(&humidity)
              );
    } else {
      LOG_ERR("Failed to fet data from sensor. Error code: %d", ret);
      LOG_WRN("Check wirings");
    }
  }
  return 0;
}
```
