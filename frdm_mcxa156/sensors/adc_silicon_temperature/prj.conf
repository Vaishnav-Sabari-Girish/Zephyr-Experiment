## CMakeLists.txt
```
cmake_minimum_required(VERSION 3.20.0)

# Pull in the Zephyr build system
find_package(Zephyr REQUIRED HINTS $ENV{ZEPHYR_BASE})

project(adc_silicon_temperature)

# Export compile commands for clangd (Neovim)
set(CMAKE_EXPORT_COMPILE_COMMANDS ON)

target_sources(app PRIVATE src/main.c)
```

## prj.conf
```kconfig
# printk() enable for console output
# CONFIG_PRINTK=y

# Enable ADC
CONFIG_ADC=y

# Enable Sensors 
CONFIG_SENSOR=y

# Enable Logging 
CONFIG_LOG=y

# Enable GPIOS
CONFIG_GPIO=y
```

## boards/frdm_mcxa156.overlay
```dts
#include <zephyr/dt-bindings/adc/adc.h>
#include <zephyr/dt-bindings/adc/mcux-lpadc.h>

&lpadc0 {
    status = "okay";
    #address-cells = <1>;
    #size-cells = <0>;

    channel@0 {
        reg = <0>;
        zephyr,gain = "ADC_GAIN_1";
        zephyr,reference = "ADC_REF_EXTERNAL0";
        zephyr,acquisition-time = <ADC_ACQ_TIME(ADC_ACQ_TIME_TICKS, 131)>;
        zephyr,input-positive = <MCUX_LPADC_CH26A>;
    };
};

&temp0 {
    status = "okay";
    io-channels = <&lpadc0 0>;
};
```

## src/main.c
```c
#include <zephyr/kernel.h>
#include <zephyr/logging/log.h>
#include <zephyr/drivers/sensor.h>
#include <zephyr/device.h>


LOG_MODULE_REGISTER(silicon_logger, LOG_LEVEL_DBG);

int main(void)
{
  const struct device *const temp_dev = DEVICE_DT_GET_ANY(nxp_lpadc_temp40);

  if (temp_dev == NULL) {
    LOG_ERR("No nxp,lpadc-temp40 device found in devicetree");
    return 0;
  }

  if (!device_is_ready(temp_dev)) {
    LOG_ERR("Device is not ready %s", temp_dev -> name);
    return 0;
  }

  LOG_INF("Device %s initialized successfully", temp_dev -> name);

  while (1) {
    struct sensor_value temp_val;

    if (sensor_sample_fetch(temp_dev) < 0) {
      LOG_ERR("Failed to fetch sensor data");
      k_msleep(1000);
      continue;
    }

    if (sensor_channel_get(temp_dev, SENSOR_CHAN_DIE_TEMP, &temp_val) < 0) {
      LOG_ERR("Failed to get sensor channel");
      continue;
    }

    LOG_INF("Silicon Die Temperature: %d.%06d C", temp_val.val1, temp_val.val2);

    k_msleep(1000);
  }

  return 0;
}
```
