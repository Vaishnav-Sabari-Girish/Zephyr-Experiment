## CMakeLists.txt
```
cmake_minimum_required(VERSION 3.20.0)

# Pull in the Zephyr build system
find_package(Zephyr REQUIRED HINTS $ENV{ZEPHYR_BASE})

project(oled_die_temp)

# Export compile commands for clangd (Neovim)
set(CMAKE_EXPORT_COMPILE_COMMANDS ON)

target_sources(app PRIVATE src/main.c src/display_hal.c)
```

## prj.conf
```kconfig
# printk() enable for console output
# CONFIG_PRINTK=y

# Enable Logging 
CONFIG_LOG=y
CONFIG_LOG_DEFAULT_LEVEL=3

# Enable GPIOS
# CONFIG_GPIO=y

# Enable I2C 
CONFIG_I2C=y

# Display subsystem 
CONFIG_DISPLAY=y

# Display Driver (The SSD1306 driver supports even SH1106) 
CONFIG_SSD1306=y

# Enable Framebuffer
CONFIG_CHARACTER_FRAMEBUFFER=y

# Enable Heap Memory Allocation 
CONFIG_HEAP_MEM_POOL_SIZE=16384

# ADC and sensor subsystem
CONFIG_ADC=y
CONFIG_SENSOR=y

# Floating point printing support
CONFIG_CBPRINTF_FP_SUPPORT=y

# Give main thread more memory for floating-point string operations
CONFIG_MAIN_STACK_SIZE=4096
```

## src/main.c
```c
#include <zephyr/kernel.h>
#include <zephyr/device.h>
#include <zephyr/drivers/sensor.h>
#include <zephyr/logging/log.h>
#include <stdio.h>
#include "display_hal.h"

LOG_MODULE_REGISTER(die_oled_logger, LOG_LEVEL_INF);

int main(void)
{
  LOG_INF("Starting the Die Temperature and OLED application");

  if (display_hal_init() != 0) {
    LOG_ERR("Display Initialization failed.");
    return -1;
  }

  const struct device *const die_temp = DEVICE_DT_GET(DT_ALIAS(die_temp0));

  if (die_temp == NULL) {
    LOG_ERR("No device nxp,lpadc-temp40 device found in devictree");
  }

  if (!device_is_ready(die_temp)) {
    LOG_ERR("Die Temperature sensor is not ready");
    return -1;
  }

  LOG_INF("Sensor %s initialized successfully", die_temp -> name);

  char display_buffer[32];

  while (1) {
    struct sensor_value silicon_temperature;

    if (sensor_sample_fetch(die_temp) < 0) {
      LOG_ERR("Failed to fetch sensor data");
      k_msleep(1000);
      continue;
    }

    if (sensor_channel_get(die_temp, SENSOR_CHAN_DIE_TEMP, &silicon_temperature) < 0) {
      LOG_ERR("Failed to get sensor channel");
      k_msleep(1000);
      continue;
    }

    double temp_c = sensor_value_to_double(&silicon_temperature);

    LOG_INF("Silicon Die temperature: %.2f C", temp_c);

    display_hal_clear();

    /* Title */
    display_hal_set_font_size(24);
    display_hal_print("DIE TEMP", 0, 0);

    /* Actual Value */
    display_hal_set_font_size(16);

    /* Format into string and print the output in display */
    snprintf(display_buffer, sizeof(display_buffer), "Temp: %.2fC", temp_c);
    display_hal_print(display_buffer, 0, 30);

    display_hal_finalize();

    k_msleep(1000);
  }

  return 0;
}
```

## src/display_hal.c
```c
#include "display_hal.h"
#include <zephyr/device.h>
#include <zephyr/drivers/display.h>
#include <zephyr/display/cfb.h>
#include <zephyr/logging/log.h>

LOG_MODULE_REGISTER(display_hal, LOG_LEVEL_INF);

static const struct device *display_dev = DEVICE_DT_GET(DT_NODELABEL(sh1106));

int display_hal_init(void) {
  if (!device_is_ready(display_dev)) {
    LOG_ERR("Display is not ready");
    return -ENODEV;
  }

  if (display_set_pixel_format(display_dev, PIXEL_FORMAT_MONO10) != 0) {
    if (display_set_pixel_format(display_dev, PIXEL_FORMAT_MONO01) != 0) {
      LOG_ERR("Failed to set required pixel format");
      return -ENOTSUP;
    }
  }

  if (cfb_framebuffer_init(display_dev)) {
    LOG_ERR("Frame buffer initialization failed");
    return -EIO;
  }

  display_hal_clear();
  display_blanking_off(display_dev);

  /* Set a default fallback font upon initialization */
  cfb_framebuffer_set_font(display_dev, 0);

  return 0;
}

void display_hal_set_font_size(uint8_t target_height) {
  if (display_dev == NULL) return;

  uint8_t num_fonts = cfb_get_numof_fonts(display_dev);
  uint8_t f_width, f_height;

  for (int i = 0; i < num_fonts; i++) {
    cfb_get_font_size(display_dev, i, &f_width, &f_height);

    if (f_height == target_height) {
      cfb_framebuffer_set_font(display_dev, i);
      LOG_INF("Font changed successfully to %dx%d", f_width, f_height);
      return;
    }
  }

  LOG_ERR("Requested font size %d not found in compiled fonts!", target_height);
}

void display_hal_clear() {
  if (display_dev != NULL) {
    cfb_framebuffer_clear(display_dev, false);
  }
}

void display_hal_finalize() {
  if (display_dev != NULL) {
    cfb_framebuffer_finalize(display_dev);
  }
}

void display_hal_print(const char *text, uint8_t x, uint8_t y) {
  if (display_dev != NULL) {
    cfb_print(display_dev, text, x, y);
  }
}
```

## src/display_hal.h
```c
#ifndef DISPLAY_HAL_H
#define DISPLAY_HAL_H

#include <stdint.h>

/* Initialize the display and the framebuffer */
int display_hal_init(void);

/* Clears the display, writes text at (x, y) and pushes the frame */
void display_hal_print(const char *text, uint8_t x, uint8_t y);

/* Set font size */
void display_hal_set_font_size(uint8_t target_height);

void display_hal_clear(void);

void display_hal_finalize(void);

#endif // !DISPLAY_HAL_H
```
