/ {
  chosen {
    zephyr,display = &sh1106;
  };
};

&flexcomm2_lpi2c2 {
  status = "okay";
  clock-frequency = <I2C_BITRATE_FAST>;

  sh1106: sh1106@3c {
    compatible = "sinowealth,sh1106";
    reg = <0x3c>;
    width = <128>;
    height = <64>;
    segment-offset = <2>;
    page-offset = <0>;
    display-offset = <0>;
    multiplex-ratio = <63>;
    segment-remap;
    com-invdir;
    prechargep = <0x22>;
  };
};
