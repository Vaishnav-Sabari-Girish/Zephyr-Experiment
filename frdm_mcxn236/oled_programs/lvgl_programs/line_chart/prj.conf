## CMakeLists.txt
```
cmake_minimum_required(VERSION 3.20.0)

# Pull in the Zephyr build system
find_package(Zephyr REQUIRED HINTS $ENV{ZEPHYR_BASE})

project(line_chart)

# Export compile commands for clangd (Neovim)
set(CMAKE_EXPORT_COMPILE_COMMANDS ON)

target_sources(app PRIVATE src/main.c)
```

## prj.conf
```kconfig
# System and Logging
CONFIG_LOG=y
CONFIG_LOG_DEFAULT_LEVEL=3

# Memory Allocations (Expanded to prevent boot-time Stack Overflows)
CONFIG_MAIN_STACK_SIZE=4096
CONFIG_SYSTEM_WORKQUEUE_STACK_SIZE=4096
CONFIG_HEAP_MEM_POOL_SIZE=32768

# Hardware Display Driver
CONFIG_I2C=y
CONFIG_DISPLAY=y
CONFIG_SSD1306=y

# Disable standard text graphics, enable LVGL
CONFIG_CHARACTER_FRAMEBUFFER=n
CONFIG_LVGL=y

# ---------------------------------------------------------
# THE MONOCHROME ALIGNMENT FIX 
# ---------------------------------------------------------
CONFIG_LV_COLOR_DEPTH_1=y
CONFIG_LV_Z_BITS_PER_PIXEL=1
CONFIG_LV_Z_MEM_POOL_SIZE=16384

# Force LVGL to update the whole screen at once, never partially.
# This prevents the 8-pixel unaligned memory corruption (grainy screen).
CONFIG_LV_Z_VDB_SIZE=100
CONFIG_LV_Z_FULL_REFRESH=y

# ---------------------------------------------------------
# THE MONOCHROME FONT FIX
# ---------------------------------------------------------
# Disable the default smooth font
CONFIG_LV_FONT_DEFAULT_MONTSERRAT_14=n

# Enable the 1-bit blocky pixel font
CONFIG_LV_FONT_UNSCII_8=y
CONFIG_LV_FONT_DEFAULT_UNSCII_8=y
```

## src/main.c
```c
#include <zephyr/kernel.h>
#include <zephyr/device.h>
#include <zephyr/drivers/display.h>
#include <zephyr/logging/log.h>
#include <lvgl.h>

LOG_MODULE_REGISTER(line_chart, LOG_LEVEL_INF);

int main(void)
{
  LOG_INF("Starting LVGL Line chart demo");

  const struct device *display = DEVICE_DT_GET(DT_CHOSEN(zephyr_display));
  if (!device_is_ready(display)) {
    LOG_ERR("Display is not ready");
    return -1;
  }

  display_blanking_off(display);

  if (lv_disp_get_default() == NULL) {
    LOG_ERR("LVGL failed to bind to the OLED");
    return -1;
  }

  lv_obj_t *scr = lv_scr_act();
  lv_obj_set_style_bg_color(scr, lv_color_black(), LV_PART_MAIN);
  lv_obj_set_style_text_color(scr, lv_color_white(), LV_PART_MAIN);

  lv_obj_t *title = lv_label_create(scr);
  lv_label_set_text(title, "Line Chart");
  lv_obj_align(title, LV_ALIGN_TOP_MID, 0, 2);

  lv_obj_t *chart = lv_chart_create(scr);
  lv_obj_set_size(chart, 120, 45);
  lv_obj_align(chart, LV_ALIGN_BOTTOM_MID, 0, -2);

  // Remove background grid lines
  lv_chart_set_div_line_count(chart, 0, 0);

  lv_obj_set_style_bg_color(chart, lv_color_black(), LV_PART_MAIN);
  lv_obj_set_style_border_color(chart, lv_color_white(), LV_PART_MAIN);
  lv_obj_set_style_border_width(chart, 1, LV_PART_MAIN);
  lv_obj_set_style_line_color(chart, lv_color_white(), LV_PART_ITEMS);
  lv_obj_set_style_line_width(chart, 2, LV_PART_ITEMS);

  lv_obj_set_style_size(chart, 0, 0, LV_PART_INDICATOR);

  // Data series 
  lv_chart_series_t * ser = lv_chart_add_series(chart, lv_color_white(), LV_CHART_AXIS_PRIMARY_Y);
  lv_chart_set_point_count(chart, 25);      // Show the last 25 points on the screen

  int value = 50;
  int step = 5;

  while (1) {
    value += step;

    if (value >= 90 || value <= 10) {
      step = -step;  // Reverse direction
    }
    
    /*
     * Push the value to the chart 
     * LVGL will automatically shift all the old points to the left by 1
    */
    lv_chart_set_next_value(chart, ser, value);

    lv_task_handler();

    k_msleep(100);
  }

  return 0;
}
```
