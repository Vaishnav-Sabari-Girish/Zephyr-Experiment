## CMakeLists.txt
```
cmake_minimum_required(VERSION 3.20.0)

# Pull in the Zephyr build system
find_package(Zephyr REQUIRED HINTS $ENV{ZEPHYR_BASE})

project(oled_uart_shell)

# Export compile commands for clangd (Neovim)
set(CMAKE_EXPORT_COMPILE_COMMANDS ON)

target_sources(app PRIVATE src/main.c src/display_hal.c)
```

## prj.conf
```kconfig
# printk() enable for console output
# CONFIG_PRINTK=y

# Enable Logging 
CONFIG_LOG=y
CONFIG_LOG_DEFAULT_LEVEL=3

# Enable GPIOS
# CONFIG_GPIO=y

# Enable Heap Memory for the Character framebuffer
CONFIG_HEAP_MEM_POOL_SIZE=16384

# Enable I2C 
CONFIG_I2C=y

# Enable Display Subsystem
CONFIG_DISPLAY=y

# Specific Display driver (Contains drivers even for SH1106)
CONFIG_SSD1306=y

# Character framebuffer for easy text rendering 
CONFIG_CHARACTER_FRAMEBUFFER=y

# UART Shell 
CONFIG_SHELL=y
CONFIG_SHELL_LOG_BACKEND=y

# Increase stack size
CONFIG_MAIN_STACK_SIZE=4096
CONFIG_SHELL_STACK_SIZE=4096
```

## src/main.c
```c
#include <zephyr/kernel.h>
#include <zephyr/shell/shell.h>
#include <zephyr/logging/log.h>
#include <stdio.h>
#include <string.h>
#include "display_hal.h"

LOG_MODULE_REGISTER(oled_uart_shell, LOG_LEVEL_INF);

/*
 * The Command Handler 
*/
static int cmd_oled_msg(const struct shell *sh, size_t argc, char **argv) {
  if (argc < 2) {
    shell_print(sh, "Usage: oled msg <Your Text Here>");
    return -EINVAL;
  }

  char buffer[128] = {0};
  int pos = 0;

  /* Loop through all the typed words and combine into 1 string */
  for (size_t i = 1; i < argc; i++) {
    pos += snprintf(buffer + pos, sizeof(buffer) - pos, "%s ", argv[i]);
  }

  display_hal_clear();

  display_hal_set_font_size(24);
  display_hal_print("MESSAGE", 0, 0);

  display_hal_set_font_size(16);
  display_hal_print(buffer, 0, 32);

  display_hal_finalize();

  shell_print(sh, "Success! Sent to OLED: %s", buffer);

  return 0;
}

/*
 * Command to clear screen
*/
static int cmd_oled_clear(const struct shell *sh, size_t argc, size_t **argv) {
  display_hal_clear();
  display_hal_set_font_size(24);
  display_hal_print("MESSAGE", 0, 0);
  display_hal_finalize();
  shell_print(sh, "OLED cleared");
  return 0;
}

/*
 * Register the subcommands
*/
SHELL_STATIC_SUBCMD_SET_CREATE(sub_oled,
                               SHELL_CMD_ARG(msg, NULL, "Print message to OLED (eg: oled msg Hello World", cmd_oled_msg, 2, 255),
                               SHELL_CMD(clear, NULL, "Clear the OLED screen", cmd_oled_clear),
                               SHELL_SUBCMD_SET_END
);

/*
 * Register the root command (oled)
*/
SHELL_CMD_REGISTER(oled, &sub_oled, "OLED display commands", NULL);

int main(void)
{
  if (display_hal_init() != 0) {
    LOG_ERR("Display init failed");
    return -1;
  }

  display_hal_clear();
  display_hal_set_font_size(24);
  display_hal_print("MESSAGE", 0, 0);
  display_hal_finalize();

  // No while(1) loop because the shell automatically
  // runs in a background thread

  return 0;
}
```

## src/display_hal.c
```c
#include "display_hal.h"
#include <zephyr/device.h>
#include <zephyr/drivers/display.h>
#include <zephyr/display/cfb.h>
#include <zephyr/logging/log.h>

LOG_MODULE_REGISTER(display_hal, LOG_LEVEL_INF);

static const struct device *display_dev = DEVICE_DT_GET(DT_NODELABEL(sh1106));

int display_hal_init(void) {
  if (!device_is_ready(display_dev)) {
    LOG_ERR("Display is not ready");
    return -ENODEV;
  }

  if (display_set_pixel_format(display_dev, PIXEL_FORMAT_MONO10) != 0) {
    if (display_set_pixel_format(display_dev, PIXEL_FORMAT_MONO01) != 0) {
      LOG_ERR("Failed to set required pixel format");
      return -ENOTSUP;
    }
  }

  if (cfb_framebuffer_init(display_dev)) {
    LOG_ERR("Frame buffer initialization failed");
    return -EIO;
  }

  display_hal_clear();
  display_blanking_off(display_dev);

  /* Set a default fallback font upon initialization */
  cfb_framebuffer_set_font(display_dev, 0);

  return 0;
}

void display_hal_set_font_size(uint8_t target_height) {
  if (display_dev == NULL) return;

  uint8_t num_fonts = cfb_get_numof_fonts(display_dev);
  uint8_t f_width, f_height;

  for (int i = 0; i < num_fonts; i++) {
    cfb_get_font_size(display_dev, i, &f_width, &f_height);

    if (f_height == target_height) {
      cfb_framebuffer_set_font(display_dev, i);
      LOG_INF("Font changed successfully to %dx%d", f_width, f_height);
      return;
    }
  }

  LOG_ERR("Requested font size %d not found in compiled fonts!", target_height);
}

void display_hal_clear() {
  if (display_dev != NULL) {
    cfb_framebuffer_clear(display_dev, false);
  }
}

void display_hal_finalize() {
  if (display_dev != NULL) {
    cfb_framebuffer_finalize(display_dev);
  }
}

void display_hal_print(const char *text, uint8_t x, uint8_t y) {
  if (display_dev != NULL) {
    cfb_print(display_dev, text, x, y);
  }
}
```

## src/display_hal.h
```c
#ifndef DISPLAY_HAL_H
#define DISPLAY_HAL_H

#include <stdint.h>

/* Initialize the display and the framebuffer */
int display_hal_init(void);

/* Clears the display, writes text at (x, y) and pushes the frame */
void display_hal_print(const char *text, uint8_t x, uint8_t y);

/* Set font size */
void display_hal_set_font_size(uint8_t target_height);

void display_hal_clear(void);

void display_hal_finalize(void);


#endif // !DISPLAY_HAL_H
```
