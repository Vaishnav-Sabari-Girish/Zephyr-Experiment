## CMakeLists.txt
```
cmake_minimum_required(VERSION 3.20.0)

# Pull in the Zephyr build system
find_package(Zephyr REQUIRED HINTS $ENV{ZEPHYR_BASE})

project(oled_display_simple)

# Export compile commands for clangd (Neovim)
set(CMAKE_EXPORT_COMPILE_COMMANDS ON)

target_sources(app PRIVATE src/main.c src/display_hal.c)
```

## prj.conf
```kconfig
# printk() enable for console output
# CONFIG_PRINTK=y

# Enable Logging 
CONFIG_LOG=y
CONFIG_LOG_DEFAULT_LEVEL=3

# Enable GPIOS
# CONFIG_GPIO=y

# Enable Heap Memory for the Character framebuffer
CONFIG_HEAP_MEM_POOL_SIZE=16384

# Enable I2C 
CONFIG_I2C=y

# Enable Display Subsystem
CONFIG_DISPLAY=y

# Specific Display driver (Contains drivers even for SH1106)
CONFIG_SSD1306=y

# Character framebuffer for easy text rendering 
CONFIG_CHARACTER_FRAMEBUFFER=y
```

## src/main.c
```c
#include <zephyr/kernel.h>
#include <zephyr/logging/log.h>
#include "display_hal.h"

LOG_MODULE_REGISTER(display_main, LOG_LEVEL_INF);

int main(void)
{
  LOG_INF("OLED application for FRDM-MCXN236");

  if (display_hal_init() != 0) {
    LOG_ERR("Failed to initialize Display HAL");
    return -1;
  }

  LOG_INF("Drawing to screen");

  display_hal_print("Hello World", 10, 20);

  while (1) {
    k_sleep(K_SECONDS(1));
  }

  return 0;
}
```

## src/display_hal.c
```c
#include "display_hal.h"
#include <zephyr/device.h>
#include <zephyr/drivers/display.h>
#include <zephyr/display/cfb.h>
#include <zephyr/logging/log.h>

LOG_MODULE_REGISTER(display_hal, LOG_LEVEL_INF);

static const struct device *display_dev = DEVICE_DT_GET(DT_NODELABEL(sh1106));

int display_hal_init(void) {
  if (!device_is_ready(display_dev)) {
    LOG_ERR("Display is not ready");
    return -ENODEV;
  }

  if (display_set_pixel_format(display_dev, PIXEL_FORMAT_MONO10) != 0) {
    if (display_set_pixel_format(display_dev, PIXEL_FORMAT_MONO01) != 0) {
      LOG_ERR("Failed to set required pixel format");
      return -ENOTSUP;
    }
  }

  if (cfb_framebuffer_init(display_dev)) {
    LOG_ERR("Frame buffer initialization failed");
    return -EIO;
  }

  cfb_framebuffer_clear(display_dev, true);
  display_blanking_off(display_dev);

  return 0;
}

void display_hal_print(const char *text, uint8_t x, uint8_t y) {
  if (display_dev == NULL) return;

  cfb_framebuffer_clear(display_dev, false);
  cfb_print(display_dev, text, x, y);
  cfb_framebuffer_finalize(display_dev);
}
```

## src/display_hal.h
```c
#ifndef DISPLAY_HAL_H
#define DISPLAY_HAL_H

#include <stdint.h>

/* Initialize the display and the framebuffer */
int display_hal_init(void);

/* Clears the display, writes text at (x, y) and pushes the frame */
void display_hal_print(const char *text, uint8_t x, uint8_t y);

#endif // !DISPLAY_HAL_H
```
